// SPDX-License-Identifier: Apache-2.0
// ST7703 initialization adapted from Waveshare component 3.0.1.
#include "esp_lcd_st7703.h"

#include <stdlib.h>
#include <driver/gpio.h>
#include <esp_lcd_panel_commands.h>
#include <esp_lcd_panel_io.h>
#include <esp_lcd_panel_ops.h>
#include <freertos/FreeRTOS.h>
#include <freertos/task.h>
#include <soc/soc_caps.h>

#if SOC_MIPI_DSI_SUPPORTED

typedef struct {
  uint8_t cmd;
  const uint8_t *data;
  uint8_t length;
  uint16_t delay_ms;
} init_command_t;

#define BYTES(...) ((const uint8_t[]){__VA_ARGS__})

static const init_command_t INIT[] = {
    {0xB9, BYTES(0xF1,0x12,0x83), 3, 0},
    {0xB1, BYTES(0x00,0x00,0x00,0xDA,0x80), 5, 0},
    {0xB2, BYTES(0x3C,0x12,0x30), 3, 0},
    {0xB3, BYTES(0x10,0x10,0x28,0x28,0x03,0xFF,0x00,0x00,0x00,0x00), 10, 0},
    {0xB4, BYTES(0x80), 1, 0},
    {0xB5, BYTES(0x0A,0x0A), 2, 0},
    {0xB6, BYTES(0x97,0x97), 2, 0},
    {0xB8, BYTES(0x26,0x22,0xF0,0x13), 4, 0},
    {0xBA, BYTES(0x31,0x81,0x0F,0xF9,0x0E,0x06,0x20,0x00,0x00,0x00,0x00,0x00,0x00,0x00,0x44,0x25,0x00,0x90,0x0A,0x00,0x00,0x01,0x4F,0x01,0x00,0x00,0x37), 27, 0},
    {0xBC, BYTES(0x47), 1, 0},
    {0xBF, BYTES(0x02,0x11,0x00), 3, 0},
    {0xC0, BYTES(0x73,0x73,0x50,0x50,0x00,0x00,0x12,0x70,0x00), 9, 0},
    {0xC1, BYTES(0x25,0x00,0x32,0x32,0x77,0xE4,0xFF,0xFF,0xCC,0xCC,0x77,0x77), 12, 0},
    {0xC6, BYTES(0x82,0x00,0xBF,0xFF,0x00,0xFF), 6, 0},
    {0xC7, BYTES(0xB8,0x00,0x0A,0x10,0x01,0x09), 6, 0},
    {0xC8, BYTES(0x10,0x40,0x1E,0x02), 4, 0},
    {0xCC, BYTES(0x0B), 1, 0},
    {0xE0, BYTES(0x00,0x0B,0x10,0x2C,0x3D,0x3F,0x42,0x3A,0x07,0x0D,0x0F,0x13,0x15,0x13,0x14,0x0F,0x16,0x00,0x0B,0x10,0x2C,0x3D,0x3F,0x42,0x3A,0x07,0x0D,0x0F,0x13,0x15,0x13,0x14,0x0F,0x16), 34, 0},
    {0xE3, BYTES(0x07,0x07,0x0B,0x0B,0x0B,0x0B,0x00,0x00,0x00,0x00,0xFF,0x00,0xC0,0x10), 14, 0},
    {0xE9, BYTES(0xC8,0x10,0x0A,0x00,0x00,0x80,0x81,0x12,0x31,0x23,0x4F,0x86,0xA0,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0x00,0x00), 63, 0},
    {0xEA, BYTES(0x97,0x0C,0x09,0x09,0x09,0x78,0x00,0x00,0x00,0x00,0x00,0x00,0x9F,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0x00,0x00), 61, 0},
    {0xEF, BYTES(0xFF,0xFF,0x01), 3, 0},
    {0x11, NULL, 0, 250},
    {0x29, NULL, 0, 50},
};

esp_err_t esp_lcd_new_panel_st7703(
    esp_lcd_panel_io_handle_t io,
    const esp_lcd_panel_dev_config_t *panel_config,
    esp_lcd_panel_handle_t *out_panel) {
  if (!io || !panel_config || !panel_config->vendor_config || !out_panel) {
    return ESP_ERR_INVALID_ARG;
  }
  const st7703_vendor_config_t *vendor =
      (const st7703_vendor_config_t *)panel_config->vendor_config;
  if (!vendor->dsi_bus || !vendor->dpi_config) return ESP_ERR_INVALID_ARG;

  if (panel_config->reset_gpio_num >= 0) {
    gpio_config_t gpio = {
        .pin_bit_mask = 1ULL << panel_config->reset_gpio_num,
        .mode = GPIO_MODE_OUTPUT,
    };
    esp_err_t err = gpio_config(&gpio);
    if (err != ESP_OK) return err;
    gpio_set_level(panel_config->reset_gpio_num, 1);
    vTaskDelay(pdMS_TO_TICKS(5));
    gpio_set_level(panel_config->reset_gpio_num, 0);
    vTaskDelay(pdMS_TO_TICKS(10));
    gpio_set_level(panel_config->reset_gpio_num, 1);
    vTaskDelay(pdMS_TO_TICKS(120));
  }

  uint8_t madctl = panel_config->rgb_ele_order == LCD_RGB_ELEMENT_ORDER_BGR
                        ? LCD_CMD_BGR_BIT : 0;
  esp_err_t err = esp_lcd_panel_io_tx_param(io, LCD_CMD_MADCTL, &madctl, 1);
  if (err != ESP_OK) return err;
  for (size_t i = 0; i < sizeof(INIT) / sizeof(INIT[0]); ++i) {
    err = esp_lcd_panel_io_tx_param(
        io, INIT[i].cmd, INIT[i].data, INIT[i].length);
    if (err != ESP_OK) return err;
    if (INIT[i].delay_ms) vTaskDelay(pdMS_TO_TICKS(INIT[i].delay_ms));
  }

  esp_lcd_panel_handle_t panel = NULL;
  err = esp_lcd_new_panel_dpi(vendor->dsi_bus, vendor->dpi_config, &panel);
  if (err != ESP_OK) return err;
  *out_panel = panel;
  return ESP_OK;
}

#else
esp_err_t esp_lcd_new_panel_st7703(
    esp_lcd_panel_io_handle_t io,
    const esp_lcd_panel_dev_config_t *panel_config,
    esp_lcd_panel_handle_t *out_panel) {
  (void)io;
  (void)panel_config;
  (void)out_panel;
  return ESP_ERR_NOT_SUPPORTED;
}
#endif
